## configs/pocketbeagle_defconfig
```kconfig
BR2_arm=y
BR2_cortex_a8=y
BR2_TOOLCHAIN_BUILDROOT_GLIBC=y
BR2_KERNEL_HEADERS_4_9=y
BR2_INIT_SYSTEMD=y
BR2_TARGET_GENERIC_ROOT_PASSWD="root"
BR2_SYSTEM_BIN_SH_BASH=y
BR2_TARGET_GENERIC_GETTY_PORT="ttyS0 ttyGS0"
BR2_ROOTFS_POST_BUILD_SCRIPT="board/pocketbeagle/post-build.sh"
BR2_ROOTFS_POST_IMAGE_SCRIPT="board/pocketbeagle/post-image.sh"
BR2_LINUX_KERNEL=y
BR2_LINUX_KERNEL_CUSTOM_GIT=y
BR2_LINUX_KERNEL_CUSTOM_REPO_URL="https://github.com/beagleboard/linux"
BR2_LINUX_KERNEL_CUSTOM_REPO_VERSION="4.14.56-ti-r64"
BR2_LINUX_KERNEL_PATCH="board/pocketbeagle/patches/add-universal-overlay.patch"
BR2_LINUX_KERNEL_DEFCONFIG="bb.org"
BR2_LINUX_KERNEL_DTS_SUPPORT=y
BR2_LINUX_KERNEL_INTREE_DTS_NAME="am335x-pocketbeagle am335x-evm am335x-bone am335x-boneblack am335x-boneblack-wireless am335x-bonegreen am335x-bonegreen-wireless am335x-abbbi am335x-boneblue am335x-sancloud-bbe am335x-evmsk"
BR2_LINUX_KERNEL_INSTALL_TARGET=y
BR2_PACKAGE_XZ=y
BR2_PACKAGE_BEAGLETESTER=y
BR2_PACKAGE_LIBGPIOD=y
BR2_PACKAGE_LIBGPIOD_TOOLS=y
BR2_PACKAGE_DNSMASQ=y
BR2_PACKAGE_DROPBEAR=y
BR2_TARGET_ROOTFS_EXT2=y
BR2_TARGET_ROOTFS_EXT2_4=y
BR2_TARGET_ROOTFS_EXT2_SIZE="230M"
BR2_TARGET_UBOOT=y
BR2_TARGET_UBOOT_BUILD_SYSTEM_KCONFIG=y
BR2_TARGET_UBOOT_CUSTOM_GIT=y
BR2_TARGET_UBOOT_CUSTOM_REPO_URL="https://github.com/jadonk/u-boot"
BR2_TARGET_UBOOT_CUSTOM_REPO_VERSION="9b089ac75432bae26f8d5934d7082c9972a83810"
BR2_TARGET_UBOOT_BOARD_DEFCONFIG="am335x_evm_usbspl"
BR2_TARGET_UBOOT_NEEDS_DTC=y
# BR2_TARGET_UBOOT_FORMAT_BIN is not set
BR2_TARGET_UBOOT_FORMAT_IMG=y
BR2_TARGET_UBOOT_FORMAT_CUSTOM=y
BR2_TARGET_UBOOT_FORMAT_CUSTOM_NAME="spl/u-boot-spl.bin"
BR2_TARGET_UBOOT_SPL=y
BR2_TARGET_UBOOT_SPL_NAME="MLO spl/u-boot-spl.bin"
BR2_PACKAGE_HOST_DOSFSTOOLS=y
BR2_PACKAGE_HOST_GENIMAGE=y
BR2_PACKAGE_HOST_MTOOLS=y
BR2_PACKAGE_HOST_UBOOT_TOOLS=y
```

## package/bborg_overlays/Config.in
```kconfig
config BR2_PACKAGE_BBORG_OVERLAYS
	bool "bborg_overlays"
	depends on BR2_PACKAGE_HOST_DTC
	help
	  Device tree overlays required to support most BeagleBoard.org
	  products. See https://beagleboard.org.

	  https://github.com/beagleboard/bb.org-overlays
```

## package/beagletester/Config.in
```kconfig
config BR2_PACKAGE_BEAGLETESTER
	bool "beagletester"
	help
	  beagle-tester tests the function of many BeagleBoard.org
	  products. See https://beagleboard.org.

	  https://github.com/jadonk/beagle-tester
```

## package/libroboticscape/Config.in
```kconfig
config BR2_PACKAGE_LIBROBOTICSCAPE
	bool "libroboticscape"
	help
	  libroboticscape supports sensors and motor drivers on
	  BeagleBoard.org BeagleBone Blue and BeagleBoard.org
	  Robotics Cape with either BeagleBoard.org BeagleBone Black
	  or BeagleBoard.org BeagleBone Black Wireless.

	  https://github.com/StrawsonDesign/Robotics_Cape_Installer
```
